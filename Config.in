## packages/citronics-initramfs/Config.in
```kconfig
config BR2_PACKAGE_CITRONICS_INITRAMFS
	bool "citronics-initramfs [Galaxy S III Neo]"
	depends on !BR2_STATIC_LIBS
	depends on BR2_USE_MMU
	depends on BR2_TOOLCHAIN_HAS_THREADS
	depends on BR2_INSTALL_LIBSTDCPP
	select BR2_PACKAGE_BUSYBOX
	select BR2_PACKAGE_MULTIPATH_TOOLS
	help
	  Early-boot initramfs. lk2nd loads it alongside the kernel; it
	  finds the stock `userdata` partition by GPT name, maps the Nerves
	  subpartitions out of it with kpartx, mounts the squashfs rootfs
	  and pivots into it. If any of that fails it brings up USB
	  networking (10.0.42.1) and a telnet shell instead of leaving you
	  with a black screen.
```

## packages/s3ve3g-firmware/Config.in
```kconfig
config BR2_PACKAGE_S3VE3G_FIRMWARE
	bool "s3ve3g-firmware [Galaxy S III Neo]"
	select BR2_PACKAGE_KMOD
	select BR2_PACKAGE_KMOD_TOOLS
	select BR2_PACKAGE_WIRELESS_REGDB
	help
	  Firmware plumbing for the Galaxy S III Neo. Ships no firmware.

	  The WCNSS (Pronto) Wi-Fi/Bluetooth image lives on the phone's
	  own `apnhlos` partition and its NV calibration on `system`; the
	  MAC addresses live on `efs`. None of it may be redistributed, and
	  every phone has its own. s3ve3g-bringup, run by erlinit before
	  Erlang starts, links the images it finds on the read-only stock
	  partitions into /run/firmware, points the kernel firmware loader
	  there, copies the MAC addresses to /run/s3ve3g and loads the
	  drivers.
```
